#include "snow_1.dtsi"

&kscan0 {
    row-gpios
        = <&pro_micro 20 (GPIO_ACTIVE_HIGH | GPIO_PULL_DOWN)> // Row 0 (num):    P0.29
        , <&pro_micro 21 (GPIO_ACTIVE_HIGH | GPIO_PULL_DOWN)> // Row 1 (top):    P0.31
        , <&pro_micro 18 (GPIO_ACTIVE_HIGH | GPIO_PULL_DOWN)> // Row 2 (home):   P1.15
        , <&pro_micro 16 (GPIO_ACTIVE_HIGH | GPIO_PULL_DOWN)> // Row 3 (bottom): P0.10
        , <&pro_micro 7  (GPIO_ACTIVE_HIGH | GPIO_PULL_DOWN)> // Row 4 (mod):    P0.11
        ;

    col-gpios
        = <&pro_micro 9 GPIO_ACTIVE_HIGH>  // Col 0 (c1): P106 (P1.06)
        , <&pro_micro 0 GPIO_ACTIVE_HIGH>  // Col 1 (c2): P008 (P0.08)
        , <&pro_micro 10 GPIO_ACTIVE_HIGH>  // Col 2 (c3): P009 (P0.09)
        , <&pro_micro 3 GPIO_ACTIVE_HIGH>  // Col 3 (c4): P020 (P0.20)
        , <&pro_micro 14 GPIO_ACTIVE_HIGH>  // Col 4 (c5): P111 (P1.11)
        , <&pro_micro 5 GPIO_ACTIVE_HIGH>  // Col 5 (c6): P024 (P0.24)
        , <&pro_micro 6 GPIO_ACTIVE_HIGH>  // Col 6 (c7): P100 (P1.00)
        ;
};
