#include "snow_1.dtsi"

&default_transform { // Offset of 7 because the left side has 7 columns
    col-offset = <7>;
};

&kscan0 {
    row-gpios
        = <&pro_micro 20 (GPIO_ACTIVE_HIGH | GPIO_PULL_DOWN)> // Row 0 (num):    P029 (P0.29)
        , <&pro_micro 21 (GPIO_ACTIVE_HIGH | GPIO_PULL_DOWN)> // Row 1 (top):    P031 (P0.31)
        , <&pro_micro 9 (GPIO_ACTIVE_HIGH | GPIO_PULL_DOWN)> // Row 2 (home):   P106 (P1.06)
        , <&pro_micro 8 (GPIO_ACTIVE_HIGH | GPIO_PULL_DOWN)> // Row 3 (bottom): P104 (P1.04)
        , <&pro_micro 7  (GPIO_ACTIVE_HIGH | GPIO_PULL_DOWN)> // Row 4 (mod):    P011 (P0.11)
        ;

    col-gpios
        = <&pro_micro 1 GPIO_ACTIVE_HIGH>   // Col 0 (c1): P006 (P0.06)
        , <&pro_micro 0 GPIO_ACTIVE_HIGH>   // Col 1 (c2): P008 (P0.08)
        , <&pro_micro 15 GPIO_ACTIVE_HIGH>  // Col 2 (c3): P113 (P1.13)
        , <&pro_micro 14 GPIO_ACTIVE_HIGH>   // Col 3 (c4): P111 (P1.11)
        , <&pro_micro 10 GPIO_ACTIVE_HIGH>  // Col 4 (c5): P009 (P0.09)
        , <&pro_micro 5 GPIO_ACTIVE_HIGH>   // Col 5 (c6): P024 (P0.24)
        ;
};
