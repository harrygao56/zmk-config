## boards/shields/snow-1/Kconfig.defconfig
```kconfig
if SHIELD_SNOW_1_LEFT

# Name must be less than 16 characters long!
config ZMK_KEYBOARD_NAME
    default "snow-1"

config ZMK_SPLIT_ROLE_CENTRAL
    default y

endif

if SHIELD_SNOW_1_LEFT || SHIELD_SNOW_1_RIGHT

config ZMK_SPLIT
    default y

endif
```

## boards/shields/snow-1/Kconfig.shield
```kconfig
# No whitespace after the comma or in your part name!
config SHIELD_SNOW_1_LEFT
    def_bool $(shields_list_contains,snow_1_left)

# No whitespace after the comma or in your part name!
config SHIELD_SNOW_1_RIGHT
    def_bool $(shields_list_contains,snow_1_right)
```

## config/west.yml
```yaml
manifest:
  defaults:
    revision: v0.3
  remotes:
    - name: zmkfirmware
      url-base: https://github.com/zmkfirmware
    - name: harryzmk
      url-base: https://github.com/harrygao56
  projects:
    - name: zmk
      remote: harryzmk
      revision: main
      import: app/west.yml
  self:
    path: config
```
